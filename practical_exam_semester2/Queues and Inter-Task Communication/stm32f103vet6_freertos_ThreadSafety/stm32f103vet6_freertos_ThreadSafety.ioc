# file: stm32f103vet6_freertos_ThreadSafety.ioc
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FREERTOS.Queues01=sharedQueue,16,uint32_t,0,Dynamic,NULL,NULL
FREERTOS.Tasks01=defaultTask,24,128,StartDefaultTask,Default,NULL,Dynamic,NULL,NULL;Sender1Task,24,128,StartSender1Task,Default,NULL,Dynamic,NULL,NULL;Sender2Task,24,128,StartSender2Task,Default,NULL,Dynamic,NULL,NULL;QueueRxTask,24,128,StartQueueRxTask,Default,NULL,Dynamic,NULL,NULL
Mcu.Family=STM32F1
Mcu.Name=STM32F103V(C-D-E)Tx
Mcu.Package=LQFP100
NVIC.PriorityGroup=NVIC_PRIORITYGROUP_4
OSC_IN.Mode=HSE-External-Oscillator
OSC_IN.Signal=RCC_OSC_IN
OSC_OUT.Mode=HSE-External-Oscillator
OSC_OUT.Signal=RCC_OSC_OUT
PA13.Mode=Trace_Asynchronous_SW
PA13.Signal=SYS_JTMS-SWDIO
PA14.Mode=Trace_Asynchronous_SW
PA14.Signal=SYS_JTCK-SWCLK
PB3.Mode=Trace_Asynchronous_SW
PB3.Signal=SYS_JTDO-TRACESWO
ProjectManager.HeapSize=0x200
ProjectManager.StackSize=0x400
ProjectManager.TargetToolchain=STM32CubeIDE
RCC.APB1Freq_Value=8000000
RCC.APB2Freq_Value=8000000
VP_FREERTOS_VS_CMSIS_V2.Mode=CMSIS_V2
board=custom

// file: Core/Src/main.c
/* USER CODE BEGIN Header */
/**
  ******************************************************************************
  * @file           : main.c
  * @brief          : Main program body
  ******************************************************************************
  * @attention
  *
  * Copyright (c) 2026 STMicroelectronics.
  * All rights reserved.
  *
  * This software is licensed under terms that can be found in the LICENSE file
  * in the root directory of this software component.
  * If no LICENSE file comes with this software, it is provided AS-IS.
  *
  ******************************************************************************
  */
/* USER CODE END Header */
#include "main.h"
#include "cmsis_os.h"

/* USER CODE BEGIN Includes */
#include <stdio.h>
typedef struct
{
    uint32_t sender_id;
    uint32_t value;
} QueueMsg_t;

/* USER CODE END Includes */

/* Definitions for defaultTask */
osThreadId_t defaultTaskHandle;
const osThreadAttr_t defaultTask_attributes = {
  .name = "defaultTask",
  .stack_size = 128 * 4,
  .priority = (osPriority_t) osPriorityNormal,
};
/* Definitions for Sender1Task */
osThreadId_t Sender1TaskHandle;
const osThreadAttr_t Sender1Task_attributes = {
  .name = "Sender1Task",
  .stack_size = 128 * 4,
  .priority = (osPriority_t) osPriorityNormal,
};
/* Definitions for Sender2Task */
osThreadId_t Sender2TaskHandle;
const osThreadAttr_t Sender2Task_attributes = {
  .name = "Sender2Task",
  .stack_size = 128 * 4,
  .priority = (osPriority_t) osPriorityNormal,
};
/* Definitions for QueueRxTask */
osThreadId_t QueueRxTaskHandle;
const osThreadAttr_t QueueRxTask_attributes = {
  .name = "QueueRxTask",
  .stack_size = 128 * 4,
  .priority = (osPriority_t) osPriorityNormal,
};
/* Definitions for sharedQueue */
osMessageQueueId_t sharedQueueHandle;
const osMessageQueueAttr_t sharedQueue_attributes = {
  .name = "sharedQueue"
};

void SystemClock_Config(void);
static void MX_GPIO_Init(void);
void StartDefaultTask(void *argument);
void StartSender1Task(void *argument);
void StartSender2Task(void *argument);
void StartQueueRxTask(void *argument);

/* USER CODE BEGIN 0 */
int _write(int file, char *ptr, int len)
{
	for(int i=0;i<len;i++)
		ITM_SendChar((*ptr++));
	return len;
}
/* USER CODE END 0 */

int main(void)
{

  /* MCU Configuration--------------------------------------------------------*/

  /* Reset of all peripherals, Initializes the Flash interface and the Systick. */
  HAL_Init();

  /* Configure the system clock */
  SystemClock_Config();

  /* Initialize all configured peripherals */
  MX_GPIO_Init();

  /* Init scheduler */
  osKernelInitialize();

  /* Create the queue(s) */
  /* creation of sharedQueue */
  sharedQueueHandle = osMessageQueueNew (16, sizeof(QueueMsg_t), &sharedQueue_attributes);

  /* Create the thread(s) */
  /* creation of defaultTask */
  defaultTaskHandle = osThreadNew(StartDefaultTask, NULL, &defaultTask_attributes);

  /* creation of Sender1Task */
  Sender1TaskHandle = osThreadNew(StartSender1Task, NULL, &Sender1Task_attributes);

  /* creation of Sender2Task */
  Sender2TaskHandle = osThreadNew(StartSender2Task, NULL, &Sender2Task_attributes);

  /* creation of QueueRxTask */
  QueueRxTaskHandle = osThreadNew(StartQueueRxTask, NULL, &QueueRxTask_attributes);

  /* Start scheduler */
  osKernelStart();

  /* We should never get here as control is now taken by the scheduler */

  /* Infinite loop */
  while (1)
  {

  }
}

void SystemClock_Config(void)
{
  RCC_OscInitTypeDef RCC_OscInitStruct = {0};
  RCC_ClkInitTypeDef RCC_ClkInitStruct = {0};

  /** Initializes the RCC Oscillators according to the specified parameters
  * in the RCC_OscInitTypeDef structure.
  */
  RCC_OscInitStruct.OscillatorType = RCC_OSCILLATORTYPE_HSI;
  RCC_OscInitStruct.HSIState = RCC_HSI_ON;
  RCC_OscInitStruct.HSICalibrationValue = RCC_HSICALIBRATION_DEFAULT;
  RCC_OscInitStruct.PLL.PLLState = RCC_PLL_NONE;
  if (HAL_RCC_OscConfig(&RCC_OscInitStruct) != HAL_OK)
  {
    Error_Handler();
  }

  /** Initializes the CPU, AHB and APB buses clocks
  */
  RCC_ClkInitStruct.ClockType = RCC_CLOCKTYPE_HCLK|RCC_CLOCKTYPE_SYSCLK
                              |RCC_CLOCKTYPE_PCLK1|RCC_CLOCKTYPE_PCLK2;
  RCC_ClkInitStruct.SYSCLKSource = RCC_SYSCLKSOURCE_HSI;
  RCC_ClkInitStruct.AHBCLKDivider = RCC_SYSCLK_DIV1;
  RCC_ClkInitStruct.APB1CLKDivider = RCC_HCLK_DIV1;
  RCC_ClkInitStruct.APB2CLKDivider = RCC_HCLK_DIV1;

  if (HAL_RCC_ClockConfig(&RCC_ClkInitStruct, FLASH_LATENCY_0) != HAL_OK)
  {
    Error_Handler();
  }
}

static void MX_GPIO_Init(void)
{

  /* GPIO Ports Clock Enable */
  __HAL_RCC_GPIOA_CLK_ENABLE();
  __HAL_RCC_GPIOB_CLK_ENABLE();

}

void StartDefaultTask(void *argument)
{
  for(;;)
  {
    osDelay(1);
  }
}

void StartSender1Task(void *argument)
{
  /* USER CODE BEGIN StartSender1Task */
  /* Infinite loop */
	  QueueMsg_t msg;
	  msg.sender_id = 1;
	  msg.value = 0;
  for(;;)
  {
      msg.value++;
      osMessageQueuePut(sharedQueueHandle, &msg, 0, osWaitForever);
      osDelay(3000);
  }
  /* USER CODE END StartSender1Task */
}

void StartSender2Task(void *argument)
{
  /* USER CODE BEGIN StartSender2Task */
  /* Infinite loop */
	  QueueMsg_t msg;
	  msg.sender_id = 2;
	  msg.value = 1000;
  for(;;)
  {
      msg.value--;
      osMessageQueuePut(sharedQueueHandle, &msg, 0, osWaitForever);
      osDelay(5000);
  }
  /* USER CODE END StartSender2Task */
}

void StartQueueRxTask(void *argument)
{
  /* USER CODE BEGIN StartQueueRxTask */
  /* Infinite loop */
	  QueueMsg_t rx;
  for(;;)
  {
      if (osMessageQueueGet(sharedQueueHandle, &rx, NULL, osWaitForever) == osOK)
      {
          printf("RX from Sender%lu value=%lu\r\n", rx.sender_id, rx.value);
      }
  }
  /* USER CODE END StartQueueRxTask */
}

void Error_Handler(void)
{
  __disable_irq();
  while (1)
  {
  }
}
